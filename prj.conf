## CMakeLists.txt
```
cmake_minimum_required(VERSION 3.20.0)

list(APPEND ZEPHYR_EXTRA_MODULES ${CMAKE_CURRENT_SOURCE_DIR}/modules/libmicroxrcedds)

find_package(Zephyr REQUIRED HINTS $ENV{ZEPHYR_BASE})
project(MiracDDS)

# zephyr_include_directories(${CMAKE_CURRENT_SOURCE_DIR}/include)

if(CONFIG_MICROXRCEDDSCLIENT)
  target_link_libraries(app PRIVATE microxrceddsclient)
endif()

target_sources(app PRIVATE src/main.cpp)
```

## Kconfig
```
mainmenu "MiracZ7"

source "Kconfig.zephyr"

rsource "modules/Kconfig"
```

## west.yml
```
manifest:
  remotes:
    - name: zephyrproject-rtos
      url-base: https://github.com/zephyrproject-rtos
    
    - name: eprosima
      url-base: https://github.com/eProsima

    - name: micro-xrce-dds-client-custom
      url-base: https://github.com/discodyer

  projects:
    - name: zephyr
      remote: zephyrproject-rtos
      revision: v4.2.0
      import: true

    - name: Micro-XRCE-DDS-Client
      remote: micro-xrce-dds-client-custom
      revision: zephyr-v3.0.0
      path: modules/lib/micro-xrce-dds-client

  self:
    path: miracz7
```

## prj.conf
```kconfig
# General configurations
# CONFIG_PRINTK=y
CONFIG_SERIAL=y
CONFIG_CONSOLE=y
CONFIG_UART_CONSOLE=y
CONFIG_STDOUT_CONSOLE=y
CONFIG_CBPRINTF_FP_SUPPORT=y

CONFIG_LOG=y
CONFIG_LOG_DEFAULT_LEVEL=3
CONFIG_LOG_MODE_DEFERRED=y
CONFIG_LOG_BACKEND_UART=y

CONFIG_GPIO=y

CONFIG_CPP=y
CONFIG_STD_CPP17=y
CONFIG_MINIMAL_LIBCPP=y

# System Configuration
CONFIG_MAIN_STACK_SIZE=2048
CONFIG_MAIN_THREAD_PRIORITY=3

CONFIG_POSIX_API=y

CONFIG_USB_DEVICE_STACK=y
CONFIG_USB_CDC_ACM=y

CONFIG_STDOUT_CONSOLE=y
CONFIG_SERIAL=y
CONFIG_UART_LINE_CTRL=y

CONFIG_USB_DRIVER_LOG_LEVEL_ERR=y
CONFIG_USB_DEVICE_LOG_LEVEL_ERR=y

# Configure USB device identification
CONFIG_USB_DEVICE_MANUFACTURER="ISCAS"
CONFIG_USB_DEVICE_PRODUCT="MiracZ7"
CONFIG_USB_DEVICE_VID=0x2FE3
CONFIG_USB_DEVICE_PID=0x1145

CONFIG_MICROXRCEDDSCLIENT=y
CONFIG_MICROXRCEDDSCLIENT_TRANSPORT_SERIAL_USB=y
CONFIG_MICROXRCEDDSCLIENT_PARTICIPANT_NAME="miracz7_xrce_participant"
CONFIG_MICROXRCEDDSCLIENT_ROS_TOPIC_NAMESPACE="miracdds"
```

## boards/mini_stm32h743.overlay
```dts
#include <zephyr/dt-bindings/sensor/qdec_stm32.h>
#include <zephyr/dt-bindings/pinctrl/stm32-pinctrl.h>
#include <zephyr/dt-bindings/pwm/pwm.h>
#include <zephyr/dt-bindings/gpio/gpio.h>

/ {
    aliases {
    };
};

&zephyr_udc0 {
	cdc_xrce_dds: cdc_xrce_dds {
		compatible = "zephyr,cdc-acm-uart";
		label = "CDC_XRCE_DDS";
	};
};
```

## src/main.cpp
```c
/*
 * Copyright (c) 2025, Cody Gu <gujiaqi@iscas.ac.cn>
 * SPDX-License-Identifier: Apache-2.0
 */

#include <zephyr/kernel.h>

#include <stdio.h>
#include <string.h>
#include <stdlib.h>
#include <time.h>

#include <zephyr/sys/printk.h>

#include "mirac_dds_client.h"

int main(void)
{
    MiracDDS dds_client;

    // Initialize and start MiracDDS thread
    if (!dds_client.startThread())
    {
        printk("Failed to start MiracDDS thread\n");
    }
    else
    {
        printk("MiracDDS initialized and thread started successfully\n");
    }

    while (1)
    {
        // printk("Hello from main thread\n");
        k_sleep(K_MSEC(1000));
    };
}
```
